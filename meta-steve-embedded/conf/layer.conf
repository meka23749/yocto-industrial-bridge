## meta-steve-embedded/conf/layer.conf
```bitbake
BBPATH .= ":${LAYERDIR}"

BBFILES += "${LAYERDIR}/recipes-*/*/*.bb \
            ${LAYERDIR}/recipes-*/*/*.bbappend"

BBFILE_COLLECTIONS += "meta-steve-embedded"
BBFILE_PATTERN_meta-steve-embedded = "^${LAYERDIR}/"
BBFILE_PRIORITY_meta-steve-embedded = "6"

LAYERDEPENDS_meta-steve-embedded = "core"
LAYERSERIES_COMPAT_meta-steve-embedded = "scarthgap"
```
